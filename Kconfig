## Kconfig
```kconfig
#
#  Mcube
# 
#  Hiroyuki Chishiro
#

menu Architecture
  type exclusive
  config CONFIG_ARCH_SIM
    title Simulator
    default y
    aname sim
    mname none
    defs -DCONFIG_ARCH_SIM
    defs -DENABLE_FPU
  config CONFIG_ARCH_X86_64
    title X86_64
    default n
    aname x86_64
    mname none
    defs -DCONFIG_ARCH_X86_64
    depends CONFIG_COMPILER_GCC
  config CONFIG_ARCH_AARCH64_RASPI3
    title AARCH64 for Raspberry Pi3
    default n
    aname aarch64
    mname raspi3
    defs -DCONFIG_ARCH_AARCH64
    defs -DCONFIG_ARCH_AARCH64_RASPI3
    defs -DENABLE_FPU
  config CONFIG_ARCH_AXIS
    title AXIS
    default n
    aname axis
    mname none
    defs -DCONFIG_ARCH_AXIS
endmenu

menu Compiler
  type exclusive
  config CONFIG_COMPILER_CLANG
    title Clang Compiler
    default n
    ccname clang
    defs -DCONFIG_COMPILER_CLANG
  config CONFIG_COMPILER_GCC
    title GCC Compiler
    default y
    ccname gcc
    defs -DCONFIG_COMPILER_GCC
endmenu

menu Print
  type exclusive
  config CONFIG_PRINT2CONSOLE
    title Print to Console
    default y
    oname console
    defs -DCONFIG_PRINT2CONSOLE
    conflicts CONFIG_ARCH_AARCH64
  config CONFIG_PRINT2UART
    title Print to UART
    default n
    oname uart
    defs -DCONFIG_PRINT2UART
    conflicts CONFIG_ARCH_SIM
    conflicts CONFIG_ARCH_AXIS
endmenu

menu Algorithm
  type exclusive
  config CONFIG_ALGO_FP
    title Fixed-Priority (FP) FIFO Scheduling
    default y
    alname fp
    defs -DCONFIG_ALGO_FP
    defs -DSCHED_FP
  config CONFIG_ALGO_RM
    title Rate Monotonic (RM) Scheduling
    default n
    alname rm
    defs -DCONFIG_ALGO_RM
    defs -DSCHED_FP
  config CONFIG_ALGO_EDF
    title Earliest Deadline First (EDF) Scheduling
    default n
    alname edf
    defs -DCONFIG_ALGO_EDF
    defs -DSCHED_DP
    conflicts CONFIG_TQ_O1
endmenu

menu Task Queue
  type exclusive
  config CONFIG_TQ_O1
    title O(1) Scheduler
    default y
    cfiles $(TOP_DIR)/kernel/queue/o1.c
    defs -DCONFIG_TQ_O1
    conflicts SCHED_DP
  config CONFIG_TQ_BHEAP
    title O(log n) Binomial Heap
    default n
    cfiles $(TOP_DIR)/kernel/queue/bheap.c
    defs -DCONFIG_TQ_BHEAP
  config CONFIG_TQ_DLIST
    title O(n) Double Circular Linked List
    default n
    cfiles $(TOP_DIR)/kernel/queue/dlist.c
    defs -DCONFIG_TQ_DLIST
endmenu

menu Tie-Break
  type exclusive
  config  CONFIG_TIE_BREAK_FIFO
    title Tie Break by FIFO
    default y
    defs -DCONFIG_TIE_BREAK_FIFO
  config  CONFIG_TIE_BREAK_ID
    title Tie Break by ID
    default n
    defs -DCONFIG_TIE_BREAK_ID
endmenu

menu Option
  type none
  config CONFIG_OPTION_DEBUG
    title Debug
    default y
    defs -DCONFIG_OPTION_DEBUG
  config CONFIG_OPTION_FS_EXT2
    title Ext2 File System
    default n
    cfiles $(TOP_DIR)/fs/ext2/ext2.c
    cfiles $(TOP_DIR)/fs/ext2/files_list.c
    defs -DCONFIG_OPTION_FS_EXT2
    depends CONFIG_ARCH_X86_64
    conflicts CONFIG_OPTION_FS_FAT
  config CONFIG_OPTION_FS_FAT
    title Fat File System
    default n
    cfiles $(TOP_DIR)/fs/fat/fat.c
    defs -DCONFIG_OPTION_FS_FAT
    depends CONFIG_ARCH_AARCH64_RASPI3
    conflicts CONFIG_OPTION_FS_EXT2
endmenu
```
